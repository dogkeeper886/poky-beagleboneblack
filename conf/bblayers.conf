## conf/bblayers.conf
```bitbake
# POKY_BBLAYERS_CONF_VERSION is increased each time build/conf/bblayers.conf
# changes incompatibly
POKY_BBLAYERS_CONF_VERSION = "2"

BBPATH = "${TOPDIR}"
BBFILES ?= ""

BBLAYERS ?= " \
  /home/jack/src/poky/meta \
  /home/jack/src/poky/meta-poky \
  /home/jack/src/poky/meta-yocto-bsp \
  /home/jack/Projects/beaglebone-black/workspace \
  /home/jack/src/meta-usb-wifi-adapter \
  "
```
